## board/seco/Kconfig
```kconfig
choice
	prompt "SECO Memory Settings"

config SECOMX6_256MB_1x256
	bool "1x256MB"


config SECOMX6_512MB_2x256
	bool "2x256MB"


config SECOMX6_1GB_2x512
	bool "2x512MB"


config SECOMX6_1GB_4x256
	bool "4x256MB"


config SECOMX6_2GB_4x512
	bool "4x512MB"


config SECOMX6_4GB_8x512
	bool "8x512MB"


config SECOMX6_DDR_DYNAMIC_SIZE
	bool "dynamic size"

endchoice
```

## board/seco/Q7_928/Kconfig
```kconfig
if TARGET_MX6QDL_SECO_Q7_928

config SYS_BOARD
        default "Q7_928"

config SYS_VENDOR
        default "seco"

config SYS_CONFIG_NAME
        default "mx6qdl_seco_q7_928"

config SYS_TEXT_BASE
    default 0x17800000

endif
```

## board/seco/SBC_A62/Kconfig
```kconfig
if TARGET_MX6QDL_SECO_SBC_A62

config SYS_BOARD
        default "SBC_A62"

config SYS_VENDOR
        default "seco"

config SYS_CONFIG_NAME
        default "mx6qdl_seco_sbc_a62"

config SYS_TEXT_BASE
    default 0x17800000

endif

if TARGET_MX6QDL_SECO_SYS_A62_10

config SYS_BOARD
	default "SBC_A62"

config SYS_VENDOR
	default "seco"

config SYS_CONFIG_NAME
	default "mx6qdl_seco_sys_a62_10"

config SYS_TEXT_BASE
	default 0x17800000

endif
```

## board/seco/SBC_B08/Kconfig
```kconfig
if TARGET_MX6SX_SECO_SBC_B08

config SYS_BOARD
        default "SBC_B08"

config SYS_VENDOR
        default "seco"

config SYS_CONFIG_NAME
        default "mx6sx_seco_sbc_b08"

config SYS_TEXT_BASE
    default 0x87800000

endif

if TARGET_MX6SX_SECO_SYS_B08

config SYS_BOARD
        default "SBC_B08"

config SYS_VENDOR
        default "seco"

config SYS_CONFIG_NAME
        default "mx6sx_seco_sys_b08"

config SYS_TEXT_BASE
    default 0x87800000

endif
```

## board/seco/SBC_C23/Kconfig
```kconfig
if TARGET_MX6SX_SECO_SBC_C23

config SYS_BOARD
	default "SBC_C23"

config SYS_VENDOR
	default "seco"

config SYS_CONFIG_NAME
	default "mx6sx_seco_sbc_c23"

config SYS_TEXT_BASE
	default 0x87800000

endif
```

## board/seco/seco_imx8mm_c61/Kconfig
```kconfig
if TARGET_SECO_IMX8MM_C61

config SYS_BOARD
	default "seco_imx8mm_c61"

config SYS_VENDOR
	default "seco"

config SYS_CONFIG_NAME
	default "seco_imx8mm_c61"

source "board/seco/common/Kconfig"

endif
```

## board/seco/seco_imx8mm_c72/Kconfig
```kconfig
if TARGET_SECO_IMX8MM_C72

config SYS_BOARD
	default "seco_imx8mm_c72"

config SYS_VENDOR
	default "seco"

config SYS_CONFIG_NAME
	default "seco_imx8mm_c72"

source "board/seco/common/Kconfig"

endif
```

## board/seco/seco_imx8mn_c72/Kconfig
```kconfig
if TARGET_SECO_IMX8MN_C72

config SYS_BOARD
	default "seco_imx8mn_c72"

config SYS_VENDOR
	default "seco"

config SYS_CONFIG_NAME
	default "seco_imx8mn_c72"

source "board/seco/common/Kconfig"

endif
```

## board/seco/seco_imx8qm_c26/Kconfig
```kconfig
if TARGET_SECO_IMX8QM_C26

config SYS_BOARD
	default "seco_imx8qm_c26"

config SYS_VENDOR
	default "seco"

config SYS_CONFIG_NAME
	default "seco_imx8qm_c26"

config  SECO_IMX8QM_C26_2GB 
        bool "Support i.MX8QM C26 with 2GB of RAM"

config  SECO_IMX8QM_C26_4GB 
        bool "Support i.MX8QM C26 with 4GB of RAM"

config  SECO_IMX8QM_C26_8GB 
        bool "Support i.MX8QM C26 with 8GB of RAM"

source "board/seco/common/Kconfig"

endif
```

## board/seco/seco_imx8qm_c43/Kconfig
```kconfig
if TARGET_SECO_IMX8QM_C43

config SYS_BOARD
	default "seco_imx8qm_c43"

config SYS_VENDOR
	default "seco"

config SYS_CONFIG_NAME
	default "seco_imx8qm_c43"

config  SECO_IMX8QM_C43_2GB 
        bool "Support i.MX8QM C43 with 2GB of RAM"

config  SECO_IMX8QM_C43_4GB 
        bool "Support i.MX8QM C43 with 4GB of RAM"

config  SECO_IMX8QM_C43_8GB 
        bool "Support i.MX8QM C43 with 8GB of RAM"

source "board/seco/common/Kconfig"

endif
```

## board/seco/seco_imx8qxp_c57/Kconfig
```kconfig
if TARGET_SECO_IMX8QXP_C57

config SYS_BOARD
	default "seco_imx8qxp_c57"

config SYS_VENDOR
	default "seco"

config SYS_CONFIG_NAME
	default "seco_imx8qxp_c57"

source "board/seco/common/Kconfig"

endif
```

## board/seco/seco_imx8qxp_d16/Kconfig
```kconfig
if TARGET_SECO_IMX8QXP_D16

config SYS_BOARD
	default "seco_imx8qxp_d16"

config SYS_VENDOR
	default "seco"

config SYS_CONFIG_NAME
	default "seco_imx8qxp_d16"

source "board/seco/common/Kconfig"

endif
```

## board/seco/uQ7_962/Kconfig
```kconfig
if TARGET_MX6QDL_SECO_uQ7_962

config SYS_BOARD
        default "uQ7_962"

config SYS_VENDOR
        default "seco"

config SYS_CONFIG_NAME
        default "mx6qdl_seco_uq7_962"

config SYS_TEXT_BASE
    default 0x17800000

endif
```

## board/seco/uQ7_J_A75/Kconfig
```kconfig
if TARGET_MX6QDL_SECO_uQ7_J_A75

config SYS_BOARD
        default "uQ7_J_A75"

config SYS_VENDOR
        default "seco"

config SYS_CONFIG_NAME
        default "mx6qdl_seco_uq7_j_a75"

config SYS_TEXT_BASE
    default 0x17800000

endif
```

## configs/mx6qdl_seco_SYS_A62_10_1G_4x256M_defconfig
```kconfig
# PROCESSOR
CONFIG_ARM=y
CONFIG_ARCH_MX6=y
CONFIG_NR_DRAM_BANKS=1
CONFIG_TARGET_MX6QDL_SECO_SYS_A62_10=y
CONFIG_SYS_EXTRA_OPTIONS="IMX_CONFIG=arch/arm/mach-imx/spl_sd.cfg,MX6QDL,SPL"
# CONFIG_SYS_MALLOC_F is not set
CONFIG_SYS_TEXT_BASE=0x17800000

# RAM CONFIGURATIOn
CONFIG_SECOMX6_1GB_4x256=y

# SPL
CONFIG_SPL=y
CONFIG_SPL_LDSCRIPT=y
CONFIG_SPL_LIBCOMMON_SUPPORT=y
CONFIG_SPL_LIBGENERIC_SUPPORT=y
CONFIG_SPL_MMC_SUPPORT=y
CONFIG_SPL_SERIAL_SUPPORT=y
CONFIG_SPL_LIBDISK_SUPPORT=y
CONFIG_SPL_GPIO_SUPPORT=y
CONFIG_SPL_SEPARATE_BSS=y
CONFIG_SPL_FIT_IMAGE_TINY=y
CONFIG_SPL_FS_EXT4=y
CONFIG_SPL_I2C_SUPPORT=y
#CONFIG_SPL_OS_BOOT=y
CONFIG_SPL_RAW_IMAGE_SUPPORT=y
CONFIG_SPL_USB_HOST_SUPPORT=y
CONFIG_SPL_USB_GADGET=y
CONFIG_SPL_USB_SDP_SUPPORT=y
CONFIG_SPL_WATCHDOG_SUPPORT=y
CONFIG_SPL_FIT_PRINT=y
CONFIG_SPL_LOAD_FIT=y
# CONFIG_SPL_OF_CONTROL=y
# CONFIG_SPL_MULTI_DTB_FIT=y
# CONFIG_SPL_OF_LIST=""
# CONFIG_SPL_DM_USB is not set
# CONFIG_SPL_DOS_PARTITION is not set
#CONFIG_SPL_DM=y
CONFIG_CMD_SPL=y
CONFIG_CMD_SPL_WRITE_SIZE=0x20000

# SYSTEM
CONFIG_SUPPORT_RAW_INITRD=y
CONFIG_BOUNCE_BUFFER=y
CONFIG_HUSH_PARSER=y
CONFIG_CMD_BOOTZ=y
CONFIG_CMD_CACHE=y
CONFIG_CMD_GPIO=y
# CONFIG_CMD_FLASH is not set
CONFIG_CI_UDC=y

# ENVIRONMENT
CONFIG_SYS_CONSOLE_IS_IN_ENV=y
CONFIG_SYS_CONSOLE_OVERWRITE_ROUTINE=y
# CONFIG_CONSOLE_MUX is not set
CONFIG_BOOTDELAY=3
CONFIG_ENV_IS_IN_MMC=y
CONFIG_ENV_VARS_UBOOT_RUNTIME_CONFIG=y

CONFIG_SECO_SYSTEM_DATA=y
CONFIG_SECO_SYSDATA_IN_MMC=y
CONFIG_CMD_SECO_SYSDATA=y
CONFIG_CMD_SECO_SWITCHPART=y

# FDT
CONFIG_OF_CONTROL=y
CONFIG_DEFAULT_DEVICE_TREE="imx6q-seco_SBC_A62"
CONFIG_OF_LIST="imx6q-seco_SBC_A62 imx6dl-seco_SBC_A62"
CONFIG_DM_MMC=y
CONFIG_DM_I2C=y
CONFIG_DM_SPI=y
CONFIG_DM_SPI_FLASH=y
CONFIG_DM_USB=y
CONFIG_DM_GPIO=y
CONFIG_DM_REGULATOR=y
CONFIG_DM_REGULATOR_PFUZE100=y
CONFIG_DM_REGULATOR_FIXED=y
CONFIG_DM_REGULATOR_GPIO=y
CONFIG_DM_PMIC=y
CONFIG_DM_ETH=y
CONFIG_FIT=y
CONFIG_MULTI_DTB_FIT=y
CONFIG_PINCTRL=y
CONFIG_PINCTRL_FULL=y
CONFIG_PINCTRL_IMX6=y

# FDT FOR KERNEL
CONFIG_OF_LIBFDT=y
CONFIG_OF_LIBFDT_OVERLAY=y
CONFIG_CMD_FDT=y

# STORAGE
CONFIG_CMD_MMC=y
CONFIG_CMD_PART=y
CONFIG_CMD_SF=y
CONFIG_CMD_EXT2=y
CONFIG_CMD_EXT4=y
CONFIG_CMD_EXT4_WRITE=y
CONFIG_CMD_FAT=y
CONFIG_CMD_FS_GENERIC=y
CONFIG_EFI_PARTITION=y
CONFIG_FSL_ESDHC=y
CONFIG_FSL_USDHC=y

# PCI
#CONFIG_PCI=y
#CONFIG_CMD_PCI=y

# I2c
CONFIG_SYS_I2C=y
CONFIG_CMD_I2C=y
CONFIG_SYS_I2C_MXC=y

# SPI
CONFIG_SPI=y
CONFIG_MXC_SPI=y
CONFIG_SPI_FLASH=y
CONFIG_SF_DEFAULT_MODE=0
CONFIG_SF_DEFAULT_SPEED=20000000
CONFIG_SPI_FLASH_STMICRO=y
CONFIG_SPI_FLASH_SPANSION=y
CONFIG_SPI_FLASH_SST=y


# USB
CONFIG_USB=y
CONFIG_USB_GADGET=y
CONFIG_USB_GADGET_MANUFACTURER="FSL"
CONFIG_USB_GADGET_VENDOR_NUM=0x0525
CONFIG_USB_GADGET_PRODUCT_NUM=0xa4a5
CONFIG_USB_STORAGE=y
CONFIG_USB_HOST_ETHER=y
CONFIG_USB_ETHER_ASIX=y
CONFIG_CMD_USB=y
CONFIG_CMD_USB_SDP=y
CONFIG_CMD_USB_MASS_STORAGE=y

# ETHERNET
CONFIG_FEC_MXC=y
CONFIG_PHYLIB=y
CONFIG_MII=y
CONFIG_CMD_DHCP=y
CONFIG_CMD_MII=y
CONFIG_CMD_PING=y
CONFIG_PHY_MICREL=y
CONFIG_PHY_MICREL_KSZ90X1=y
CONFIG_PHY_MICREL_KSZ8XXX=y

# VIDEO
CONFIG_VIDEO=y
# CONFIG_VIDEO_SW_CURSOR is not set

# FASTBOOT
CONFIG_FASTBOOT_FLASH=y
CONFIG_USB_FUNCTION_FASTBOOT=y
CONFIG_FASTBOOT_BUF_ADDR=0x12000000
CONFIG_FASTBOOT_BUF_SIZE=0x10000000
CONFIG_FASTBOOT_FLASH_MMC_DEV=2
```

## configs/mx6sx_seco_SBC_C23_defconfig
```kconfig
# PROCESSOR
CONFIG_ARM=y
CONFIG_ARCH_MX6=y
CONFIG_NR_DRAM_BANKS=1
CONFIG_TARGET_MX6SX_SECO_SBC_C23=y
CONFIG_SYS_EXTRA_OPTIONS="IMX_CONFIG=arch/arm/mach-imx/spl_sd.cfg,MX6SX,SPL"
# CONFIG_SYS_MALLOC_F is not set
CONFIG_SYS_TEXT_BASE=0x87800000

# RAM CONFIGURATIOn
CONFIG_SECOMX6_DDR_DYNAMIC_SIZE=y

# SPL
CONFIG_SPL=y
CONFIG_SPL_LDSCRIPT=y
CONFIG_SPL_LIBCOMMON_SUPPORT=y
CONFIG_SPL_LIBGENERIC_SUPPORT=y
CONFIG_SPL_MMC_SUPPORT=y
CONFIG_SPL_SERIAL_SUPPORT=y
CONFIG_SPL_LIBDISK_SUPPORT=y
CONFIG_SPL_GPIO_SUPPORT=y
CONFIG_SPL_SEPARATE_BSS=y
CONFIG_SPL_FIT_IMAGE_TINY=y
CONFIG_SPL_FS_EXT4=y
CONFIG_SPL_I2C_SUPPORT=y
#CONFIG_SPL_OS_BOOT=y
CONFIG_SPL_RAW_IMAGE_SUPPORT=y
CONFIG_SPL_USB_HOST_SUPPORT=y
CONFIG_SPL_USB_GADGET=y
CONFIG_SPL_USB_SDP_SUPPORT=y
CONFIG_SPL_WATCHDOG_SUPPORT=y
CONFIG_SPL_FIT_PRINT=y
CONFIG_SPL_LOAD_FIT=y
# CONFIG_SPL_OF_CONTROL=y
# CONFIG_SPL_MULTI_DTB_FIT=y
# CONFIG_SPL_OF_LIST=""
# CONFIG_SPL_DM_USB is not set
# CONFIG_SPL_DOS_PARTITION is not set
#CONFIG_SPL_DM=y
CONFIG_CMD_SPL=y
CONFIG_CMD_SPL_WRITE_SIZE=0x20000

# SYSTEM
CONFIG_SUPPORT_RAW_INITRD=y
CONFIG_BOUNCE_BUFFER=y
CONFIG_HUSH_PARSER=y
CONFIG_CMD_BOOTZ=y
CONFIG_CMD_CACHE=y
CONFIG_CMD_GPIO=y
# CONFIG_CMD_FLASH is not set
CONFIG_CI_UDC=y

# ENVIRONMENT
CONFIG_SYS_CONSOLE_IS_IN_ENV=y
CONFIG_SYS_CONSOLE_OVERWRITE_ROUTINE=y
# CONFIG_CONSOLE_MUX is not set
CONFIG_BOOTDELAY=3
CONFIG_ENV_IS_IN_MMC=y
CONFIG_ENV_VARS_UBOOT_RUNTIME_CONFIG=y

CONFIG_SECO_SYSTEM_DATA=y
CONFIG_SECO_SYSDATA_IN_MMC=y
CONFIG_CMD_SECO_SYSDATA=y
CONFIG_CMD_SECO_SWITCHPART=y

# FDT
CONFIG_OF_CONTROL=y
CONFIG_DEFAULT_DEVICE_TREE="imx6sx-seco_SBC_C23_basic"
CONFIG_OF_LIST="imx6sx-seco_SBC_C23_full imx6sx-seco_SBC_C23_basic"
CONFIG_DM_MMC=y
CONFIG_DM_I2C=y
CONFIG_DM_SPI=y
CONFIG_DM_SPI_FLASH=y
CONFIG_DM_USB=y
CONFIG_DM_GPIO=y
CONFIG_DM_REGULATOR=y
CONFIG_DM_REGULATOR_PFUZE100=y
CONFIG_DM_REGULATOR_FIXED=y
CONFIG_DM_REGULATOR_GPIO=y
CONFIG_DM_PMIC=y
CONFIG_DM_ETH=y
CONFIG_DM_SECO_ECTRL=y
CONFIG_DM_PMIC_PFUZE100=y
CONFIG_FIT=y
CONFIG_MULTI_DTB_FIT=y
CONFIG_PINCTRL=y
CONFIG_PINCTRL_FULL=y
CONFIG_PINCTRL_IMX6=y

# FDT FOR KERNEL
CONFIG_OF_LIBFDT=y
CONFIG_OF_LIBFDT_OVERLAY=y
CONFIG_CMD_FDT=y

# STORAGE
CONFIG_CMD_MMC=y
CONFIG_CMD_PART=y
CONFIG_CMD_SF=y
CONFIG_CMD_EXT2=y
CONFIG_CMD_EXT4=y
CONFIG_CMD_EXT4_WRITE=y
CONFIG_CMD_FAT=y
CONFIG_CMD_FS_GENERIC=y
CONFIG_EFI_PARTITION=y
CONFIG_FSL_ESDHC=y
CONFIG_FSL_USDHC=y

# PCI
#CONFIG_PCI=y
#CONFIG_CMD_PCI=y

# I2c
CONFIG_SYS_I2C=y
CONFIG_CMD_I2C=y
CONFIG_SYS_I2C_MXC=y

# SPI
CONFIG_SPI=y
CONFIG_MXC_SPI=y
CONFIG_SPI_FLASH=y
CONFIG_FSL_QSPI=y
CONFIG_SF_DEFAULT_BUS=1
CONFIG_SF_DEFAULT_MODE=0
CONFIG_SF_DEFAULT_SPEED=20000000
CONFIG_SPI_FLASH_STMICRO=y
CONFIG_SPI_FLASH_SPANSION=y
CONFIG_SPI_FLASH_SST=y


# USB
CONFIG_USB=y
CONFIG_USB_GADGET=y
CONFIG_USB_GADGET_MANUFACTURER="FSL"
CONFIG_USB_GADGET_VENDOR_NUM=0x0525
CONFIG_USB_GADGET_PRODUCT_NUM=0xa4a5
CONFIG_USB_STORAGE=y
CONFIG_USB_HOST_ETHER=y
CONFIG_USB_ETHER_ASIX=y
CONFIG_CMD_USB=y
#CONFIG_CMD_USB_SDP=y
#CONFIG_CMD_USB_MASS_STORAGE=y

# ETHERNET
CONFIG_FEC_MXC=y
CONFIG_PHYLIB=y
CONFIG_MII=y
CONFIG_CMD_DHCP=y
CONFIG_CMD_MII=y
CONFIG_CMD_PING=y
CONFIG_PHY_MICREL=y
CONFIG_PHY_MICREL_KSZ90X1=y
CONFIG_PHY_MICREL_KSZ8XXX=y

# VIDEO
CONFIG_VIDEO=y
# CONFIG_VIDEO_SW_CURSOR is not set
CONFIG_SPL_I2C_SUPPORT=y
```

## drivers/seco/Kconfig
```kconfig
menu "Embedded Controller"

config DM_SECO_ECTRL
	bool "Enable Embedded Controller"
	depends on DM_I2C
	help
		This device allows you to use the Embedded Controller present on board.

endmenu
```

## sysdata/Kconfig
```kconfig
# SPDX-License-Identifier: GPL-2.0+
#
# (C) Copyright 2004-2006
# Davide Cardillo, SECO SpA, seco.com


menuconfig SECO_SYSTEM_DATA
	bool "Seco System Data"
	help
	  SECO System Data Manager


if SECO_SYSTEM_DATA

config SECO_SYSDATA_IN_MMC
	bool "System Data is placed in MMC"
	depends on SECO_SYSTEM_DATA

endif # menu SECO_SYSTEM_DATA
```
